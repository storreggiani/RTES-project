## meta-RTESLab/conf/layer.conf
```bitbake
# We have a conf and classes directory, add to BBPATH
BBPATH .= ":${LAYERDIR}"

# We have recipes-* directories, add to BBFILES
BBFILES += "${LAYERDIR}/recipes-*/*/*.bb \
            ${LAYERDIR}/recipes-*/*/*.bbappend"

BBFILE_COLLECTIONS += "meta-RTESLab"
BBFILE_PATTERN_meta-RTESLab = "^${LAYERDIR}/"
BBFILE_PRIORITY_meta-RTESLab = "6"

LAYERDEPENDS_meta-RTESLab = "core"
LAYERSERIES_COMPAT_meta-RTESLab = "honister"
```
